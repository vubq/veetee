## veetee-firmware/main/Kconfig.projbuild
```kconfig
menu "Veetee hardware bring-up"

    config VEETEE_LCD_WIDTH
        int "ST7789 visible width"
        range 80 320
        default 240

    config VEETEE_LCD_HEIGHT
        int "ST7789 visible height"
        range 80 320
        default 320

    config VEETEE_LCD_OFFSET_X
        int "ST7789 X offset"
        range 0 100
        default 0

    config VEETEE_LCD_OFFSET_Y
        int "ST7789 Y offset"
        range 0 100
        default 0

    config VEETEE_LCD_MIRROR_X
        bool "Mirror LCD on X axis"
        default n

    config VEETEE_LCD_MIRROR_Y
        bool "Mirror LCD on Y axis"
        default n

    config VEETEE_LCD_SWAP_XY
        bool "Swap LCD X/Y axes"
        default n

    config VEETEE_LCD_INVERT_COLOR
        bool "Invert ST7789 colors"
        default y

    config VEETEE_LCD_BGR_ORDER
        bool "Use BGR instead of RGB element order"
        default n

    config VEETEE_LCD_BACKLIGHT_INVERT
        bool "Invert LCD backlight output"
        default n

    config VEETEE_LCD_SPI_CLOCK_HZ
        int "LCD SPI clock (Hz)"
        range 1000000 80000000
        default 40000000

    choice VEETEE_MIC_SLOT
        prompt "INMP441 slot selected by its L/R pin"
        default VEETEE_MIC_SLOT_LEFT

        config VEETEE_MIC_SLOT_LEFT
            bool "Left slot"

        config VEETEE_MIC_SLOT_RIGHT
            bool "Right slot"
    endchoice

    config VEETEE_MIC_SAMPLE_SHIFT
        int "Right shift from INMP441 32-bit slot to PCM16"
        range 8 16
        default 12

    config VEETEE_MIC_DIAGNOSTICS
        bool "Log bounded microphone statistics"
        default y

    config VEETEE_BOOT_TONE
        bool "Play a short low-volume speaker tone on boot"
        default y

    config VEETEE_DEFAULT_VOLUME_PERCENT
        int "Default software speaker volume (percent)"
        range 0 100
        default 70
        help
            Runtime MCP/config may change this value. The firmware always keeps
            the deterministic safety boundary at 0..100.

    config VEETEE_BUTTON_LONG_PRESS_MS
        int "Assistant gate long-press threshold (ms)"
        range 500 4000
        default 1500

    config VEETEE_BUTTON_WIFI_RESET_MS
        int "Wi-Fi configuration hold threshold (ms)"
        range 4000 10000
        default 5000

    config VEETEE_WIFI_CONNECT_TIMEOUT_SECONDS
        int "Wi-Fi station timeout before AP fallback (seconds)"
        range 10 180
        default 60

    config VEETEE_DEFAULT_BOOTSTRAP_URL
        string "Optional development bootstrap URL"
        default ""
        help
            Leave empty for first-boot provisioning. A LAN URL entered in the
            portal is persisted in NVS so changing host/domain does not require
            rebuilding firmware.

    config VEETEE_ESP_SR_BRINGUP
        bool "Enable ESP-SR wake detector bring-up profile"
        default y
        select SR_WN_WN9S_HIESP
        help
            Loads ESP-SR WakeNet9s with its built-in English "Hi ESP"
            model to validate microphone fan-out, task isolation and wake
            cancellation on the target board. This is not the production
            Vietnamese/Veetee model and must be replaced by a signed model
            pack before release.

    config VEETEE_WAKE_MODEL_PARTITION
        string "ESP-SR bring-up model partition label"
        default "resource_0"
        depends on VEETEE_ESP_SR_BRINGUP
        help
            Development-only source slot for srmodels.bin. Production uses
            the verified active resource slot selected by the resource
            manifest and never overwrites both A/B slots at once.

    config VEETEE_WAKE_COOLDOWN_MS
        int "Local wake detector cooldown (ms)"
        range 250 10000
        default 1200
        depends on VEETEE_ESP_SR_BRINGUP

    config VEETEE_FIRMWARE_COMPAT_VERSION
        string "Semantic firmware compatibility version"
        default "0.2.0"
        help
            SemVer used only for signed config/resource compatibility checks.
            Git revision remains the diagnostic app version.

    config VEETEE_RESOURCE_SIGNING_KEY_ID
        string "Trusted resource signing key ID"
        default "veetee-dev-release-2026-01"
        help
            Development key ID matching the public test fixture. Production
            builds must override this value through their release sdkconfig.

    config VEETEE_RESOURCE_SIGNING_PUBLIC_KEY_HEX
        string "Trusted Ed25519 resource public key (32-byte hex)"
        default "238eb0ac501669721bbab10734bcd770a4165ab1d6c49cfb30d1e27b9088d7b7"
        help
            Public verification key only; no private signing key is stored in
            firmware or source. Production builds must use a separate key.

    config VEETEE_MIN_RESOURCE_SECURITY_EPOCH
        int "Minimum accepted resource security epoch"
        range 1 2147483647
        default 1
        help
            Rejects manifests signed before a revoked key/security epoch.

endmenu
```

## veetee-firmware/sdkconfig.defaults
```kconfig
CONFIG_IDF_TARGET="esp32s3"

CONFIG_ESPTOOLPY_FLASHSIZE_16MB=y
CONFIG_ESPTOOLPY_FLASHSIZE="16MB"

CONFIG_SPIRAM=y
CONFIG_SPIRAM_MODE_OCT=y
CONFIG_SPIRAM_SPEED_80M=y
CONFIG_SPIRAM_USE_MALLOC=y

CONFIG_PARTITION_TABLE_CUSTOM=y
CONFIG_PARTITION_TABLE_CUSTOM_FILENAME="partitions/veetee_16mb.csv"
CONFIG_PARTITION_TABLE_FILENAME="partitions/veetee_16mb.csv"

CONFIG_COMPILER_OPTIMIZATION_PERF=y
CONFIG_FREERTOS_HZ=1000
CONFIG_LOG_DEFAULT_LEVEL_INFO=y

# Conservative breadboard clock; raise only after the physical panel passes.
CONFIG_VEETEE_LCD_SPI_CLOCK_HZ=10000000
CONFIG_VEETEE_LCD_SPI_MODE=0
CONFIG_VEETEE_KEEP_SPEAKER_CLOCKED=y
# CONFIG_VEETEE_MIC_DIAGNOSTICS is not set

# Development board plumbing only. Product wake phrase "Hey VeeTee" is
# delivered later as a benchmarked, signed model-pack resource.
CONFIG_VEETEE_ESP_SR_BRINGUP=y
CONFIG_VEETEE_DEFAULT_BOOTSTRAP_URL="http://192.168.110.115:8001/veetee/ota/"
CONFIG_ESP_SYSTEM_EVENT_TASK_STACK_SIZE=4096

# Keep the ESP32-S3 Wi-Fi RX footprint aligned with Xiaozhi so SoftAP DHCP
# responses retain enough internal/DMA memory for the dynamic TX queue.
CONFIG_ESP_WIFI_DYNAMIC_RX_MGMT_BUFFER=y
CONFIG_ESP_WIFI_STATIC_RX_BUFFER_NUM=3
CONFIG_ESP_WIFI_DYNAMIC_RX_BUFFER_NUM=6
CONFIG_ESP_WIFI_RX_BA_WIN=3

# Match Xiaozhi's DHCP server path and static-ARP unicast responses.
CONFIG_LWIP_DHCPS_STATIC_ENTRIES=y
```
